## kernel/drivers/corellium/Kconfig
```kconfig
menu "Corellium"

source "drivers/corellium/d0map/Kconfig"

source "drivers/corellium/sound/Kconfig"

endmenu
```

## kernel/drivers/corellium/d0map/Kconfig
```kconfig
config D0MAP
	tristate "D0map support"
	help
	  Support for mapping Dom0 memory into VM, needed for OpenGL FBT.
```

## kernel/drivers/corellium/sound/Kconfig
```kconfig
config GOLDFISH_AUDIO_ALSA
	tristate "Goldfish Audio Device in ALSA"
	depends on GOLDFISH
	depends on SND_PCM
	help
	  Emulated audio channel for the Goldfish Android Virtual Device via ALSA
```
